## firmware/main/Kconfig.projbuild
```kconfig
menu "Wi-Fi Configuration"
    config ESP_WIFI_SSID
        string "WiFi SSID"
        help
            SSID (network name) you want to connect to.

    config ESP_WIFI_PASSWORD
        string "WiFi Password"
        help
            Password of the Wi-Fi network you want to connect to.
endmenu

menu "MQTT Configuration"
    config MQTT_BROKER_URI
        string "MQTT Broker URI"
        help
            Full URI of the MQTT broker the device connects to.
endmenu

menu "Sensor Configuration"
    config POT_ADC_UNIT
        int "Pot ADC unit (0 = ADC1, 1 = ADC2)"
        default 0
    config POT_ADC_CHANNEL
        int "Pot ADC channel"
        default 6
endmenu
```
